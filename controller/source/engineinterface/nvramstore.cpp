//## begin module%3D802415035A.cm preserve=no

//	  %X% %Q% %Z% %W%

//## end module%3D802415035A.cm



//## begin module%3D802415035A.cp preserve=no

//	Angelo Fraietta

//## end module%3D802415035A.cp



//## Module: NVRAMStore%3D802415035A; Pseudo Package body

//## Subsystem: engineinterface%3A9C858C00CB

//## Source file: c:\develop\smartcontroller\controller\source\engineinterface\nvramstore.cpp



//## begin module%3D802415035A.additionalIncludes preserve=no

#include "stdafx.h"

//## end module%3D802415035A.additionalIncludes



//## begin module%3D802415035A.includes preserve=yes

#include "evector.h"

using sm_str::vector;



#include <stdio.h>

#include <fcntl.h>

#include <dirent.h>

#include "midiflags.h"

#include "control.h"

#include "patch.h"

#include "scheduler.h"

// SessionInterface

#include "sessioninterface.h"

// PresentationAnswer

#include "presentationanswer.h"

// AnswerTask

#include "answertask.h"



#ifdef _HAL_WINDOWS

#include <sys\stat.h>

#endif



using hal_include::Scheduler;

//## end module%3D802415035A.includes



// NVRAMStore

#include "nvramstore.h"

// MidiOutputDriver

#include "midioutputdriver.h"

//## begin module%3D802415035A.additionalDeclarations preserve=yes

extern "C" int fsync (int);

// Platform Independant functions

extern "C" 

{

	const char* GetNVRAMFilename();

	void SyncNVRAM();

	void Restart();



}



static unsigned next_save_time = 0; // this is the last time the NVRAM was saved. Used to prevent multiple saves



#define MIN_SAVE_TIME 10000 // the minimum time to wait before attempting to save NVRAM



// define the Number of Milliseconds to retry

#define TIME_OUT 8000 



#define NUM_RETRIES 3



//#define USE_EEPROM

//## end module%3D802415035A.additionalDeclarations





// Class NVRAMStore 















//## begin NVRAMStore::_header_name%3D8529430164.attr preserve=no  private: static const char* {U} "SMART"

const char* NVRAMStore::_header_name = "SMART";

//## end NVRAMStore::_header_name%3D8529430164.attr











//## begin NVRAMStore::_default_path%3D891A410159.attr preserve=no  private: static string {U} ""

string NVRAMStore::_default_path = "";

//## end NVRAMStore::_default_path%3D891A410159.attr



//## begin NVRAMStore::FilesList%3D8024C801B3.role preserve=no  public: static FileBlock { -> 0..nVHN}

vector <FileBlock> NVRAMStore::FilesList;

//## end NVRAMStore::FilesList%3D8024C801B3.role





//## begin NVRAMStore::this_store%3D8276FB0347.role preserve=no  private: static NVRAMStore { -> 0..1RFHN}

NVRAMStore *NVRAMStore::this_store = 0;

//## end NVRAMStore::this_store%3D8276FB0347.role





NVRAMStore::NVRAMStore()

  //## begin NVRAMStore::NVRAMStore%.hasinit preserve=no

      : _num_files(0), _buffer_index(0), _state(idle), _total_num_bytes(0), _current_file_index(0), _failed(false), _num_tx_retries(0), _num_rx_retries(0), _event(Event::create ())

  //## end NVRAMStore::NVRAMStore%.hasinit

  //## begin NVRAMStore::NVRAMStore%.initialization preserve=yes

  //## end NVRAMStore::NVRAMStore%.initialization

{

  //## begin NVRAMStore::NVRAMStore%.body preserve=yes

  //## end NVRAMStore::NVRAMStore%.body

}





NVRAMStore::~NVRAMStore()

{

  //## begin NVRAMStore::~NVRAMStore%.body preserve=yes

  kill();

  delete _event;

  

  //## end NVRAMStore::~NVRAMStore%.body

}







//## Other Operations (implementation)

//## Operation: SaveFiles%1031879361

//	Saves and restores the file system and the current

//	filename to NVRAM

bool NVRAMStore::SaveFiles (const char* path)

{

  //## begin NVRAMStore::SaveFiles%1031879361.body preserve=yes

  bool ret = false;

	if (next_save_time > Scheduler::getTime())

		{

			return false;

		}



	if (!path)

		{

			path = _default_path.c_str();

		}

	else

		{

			_default_path = path;

		}



#ifdef USE_EEPROM

  create();



	if (this_store && this_store->_state == idle )

		{

    if (LoadFiles(path))

      {

        // get exclusive access to IO

        IOData out_data;



        // get exclusive access to IO

        out_data = EEPROM_START * 0x100;

        MidiOutputDriver::TransmitIoData (out_data);



        this_store->_state = writing;

        this_store->_buffer_index = 0;

        this_store->_total_num_bytes = 0;

				this_store->_current_file_index = 0;

				this_store->_num_rx_retries = 0;

        // set our address to zero

        out_data = EEPROM_INIT_ADDRESS *  0x100;

        MidiOutputDriver::TransmitIoData (out_data);



        // Request permission to write and pass to running thread

        // request a write to memory

        out_data = EEPROM_START_WRITE *  0x100;

        MidiOutputDriver::TransmitIoData (out_data);





        ret = true;

      }

    }

#else

		create();

		if (LoadFiles(path))

			{

				const char* nvram_file = GetNVRAMFilename();

				

				if (nvram_file)

					{

						FILE* fp = fopen(nvram_file, "w+b");

						if (fp)

							{

								ret = WriteHeader(fp);

								ret &= WriteFiles (fp);

								ret &= WritePatches (fp);

								fflush(fp);

								fsync(fileno(fp));

								fclose(fp);

								SyncNVRAM();



								if (ret)

									{

										next_save_time = MIN_SAVE_TIME + Scheduler::getTime();

										// make IO Reboot

										IOData out_data;

										

										// get exclusive access to IO

										out_data = EEPROM_START * 0x100;

										MidiOutputDriver::TransmitIoData (out_data);



										out_data = EEPROM_REBOOT * 0x100;

										MidiOutputDriver::TransmitIoData (out_data);



										// Now Update Num Patches twice in case driver misses one

										if (Patch::NumPatches())

											{

												out_data = (IOData) ((IO_FLAGS * 0x100) | (IO_PATCH_LOADED));

											}

										else

											{

												out_data = (IOData) ((IO_FLAGS * 0x100) | (IO_NO_PATCH));

											}

										MidiOutputDriver::TransmitIoData (out_data);

										MidiOutputDriver::TransmitIoData (out_data);



									}

								else

									{

										// we need to display error condition

										IOData out_data;

										

										// display error condition

										out_data = (IOData) ((IO_FLAGS * 0x100) | (IO_ERROR));

										MidiOutputDriver::TransmitIoData (out_data);

										printf ("Unable to Save Files to NVRAM\r\n");

									}

							}

					}

			}

#endif

  return ret;



  //## end NVRAMStore::SaveFiles%1031879361.body

}



//## Operation: GetNumFiles%1031879362

//	The Number of files in the system

unsigned NVRAMStore::GetNumFiles ()

{

  //## begin NVRAMStore::GetNumFiles%1031879362.body preserve=yes

  return FilesList.size();

  //## end NVRAMStore::GetNumFiles%1031879362.body

}



//## Operation: RestoreFiles%1031879363

bool NVRAMStore::RestoreFiles ()

{

  //## begin NVRAMStore::RestoreFiles%1031879363.body preserve=yes

  bool ret = false;



  create();



#ifdef USE_EEPROM

  if (this_store && this_store->_state == idle)

  {

		this_store->_num_rx_retries = 0;

    this_store->_state = reading;

    ret = this_store->ReadFiles ();

  }

#else

	const char* nvram_file = GetNVRAMFilename();



	if (nvram_file)

		{

			FILE* fp = fopen(nvram_file, "r+b");

			if (fp)

				{

					const char* message = "Restore from Disk\r\n";

					DisplayDiags (message);

					printf ("Restore NVRAM from %s\r\n", nvram_file);

					ret = ReadHeader(fp);

					if (ret)

						{

							ret = ReadFiles(fp);

						}

					if (ret)

						{

							ret = ReadPatches(fp);

						}



					fclose(fp);

					

					if (!ret)

						{

							const char* message = "Restore Failed\r\n";

							DisplayDiags (message);

						}



					SyncNVRAM();

				}

		}

#endif

  return ret;

  //## end NVRAMStore::RestoreFiles%1031879363.body

}



//## Operation: ReadFiles%1031879364

//	Performs Read of file by sending a request for Data from

//	external NVRAM

bool NVRAMStore::ReadFiles ()

{

  //## begin NVRAMStore::ReadFiles%1031879364.body preserve=yes

  // clear our list

	EraseFilesList ();



  _current_file_index = 0;

  _buffer_index = 0;

  _total_num_bytes = 0;



	IOData out_data;



	// get exclusive access to IO

	out_data = EEPROM_START * 0x100;

	MidiOutputDriver::TransmitIoData (out_data);



  // set our address to zero on our external device

  out_data = EEPROM_INIT_ADDRESS *  0x100;

  MidiOutputDriver::TransmitIoData (out_data);



  // now poll for our receive data and pass to running thread

  out_data = EEPROM_BLOCK_READ *  0x100;

  MidiOutputDriver::TransmitIoData (out_data);



	const char* message = "NVRAMStore::ReadFiles Block read\r\n";



	DisplayDiags (message);



	printf ("BlockRead\r\n");

  return true;

  //## end NVRAMStore::ReadFiles%1031879364.body

}



//## Operation: ReceiveData%1031879368

//	Function where we can receive data from Midi Driver

bool NVRAMStore::ReceiveData (IOData data)

{

  //## begin NVRAMStore::ReceiveData%1031879368.body preserve=yes

  bool ret = false;



  if (this_store)

  {

    ret = this_store->AddByte (data);

  }

  return ret;

  //## end NVRAMStore::ReceiveData%1031879368.body

}



//## Operation: run%1031888837

//	The actual function of the task. This function waits for

//	data to return from the IO before continuing

void NVRAMStore::run ()

{

  //## begin NVRAMStore::run%1031888837.body preserve=yes

	while (!Terminated())

    {

  	  if (_event->Wait(TIME_OUT))

				{

					if (!Terminated())

						{

							switch (_state)

								{

								case idle:

									break;

									

								case testing: // we have to wait until we have a whole page

								case reading:

									

									

									if (_buffer_index >= EEPROM_READ_PAGE_SIZE)

										{

											ProcessReceiveData();

										}

#ifdef SHOW_DIAG

									else

										{

											printf("Receive Byte %u\r\n", _buffer_index);

										}

#endif

									break;

									

								case erasing:

								case writing: // we are looking for our Write Ready flag

									ProcessTransmitData ();

									break;

									

								case read_internal:

									ProcessInternal();

									break;

									

								}

						}

				}

      else

				{

					// check the state that we are in

					//if we are idle -- fine -- otherwise we have lost sync with the IO

					

					if (_state != idle)

						{

              const char* message = "\r\nRestore timed out\r\n";



              DisplayDiags (message);

							printf("%s State = %u\r\n", message, _state);

							// we have to re-enable the IO

              // cause a reboot



							IOData out_data = EEPROM_REBOOT * 0x100;

							MidiOutputDriver::TransmitIoData (out_data);



							switch (_state)

								{

								case testing: // we have to wait until we have a whole page

								case reading:

									ProcessTimeout ();

									break;

								default:

									

									const char* message = "\r\nRestore timed out Unknown State\r\n";

									DisplayDiags (message);

									printf("%s State   = %u", message, (unsigned)_state);



									_state = idle;

								}

						}

				}

    }

	

  //## end NVRAMStore::run%1031888837.body

}



//## Operation: AddByte%1031888838

//	Adds a byte of data from the ReceiveData function

bool NVRAMStore::AddByte (IOData data)

{

  //## begin NVRAMStore::AddByte%1031888838.body preserve=yes

    bool ret = true;



    int flags = (data >> 8 ) & 0x007F; // get upper byte



    switch (flags) // test the data type

    {

      case EEPROM_DATA:

        if (_buffer_index < EEPROM_READ_PAGE_SIZE)

					{

						_buffer [_buffer_index] = (char)data;

					}

				else

					{

            const char* message = "EEPROM_DATA Overflow \r\n";



            DisplayDiags (message);

						printf ("EEPROM_DATA Overflow %u\r\n", _buffer_index);

					}



          _buffer_index++;



        break;



      case EEPROM_WRITE_READY:

        _event->Release();

				break;



      case EEPROM_END_READ:

#ifdef SHOW_DIAG

				if (_buffer_index < EEPROM_READ_PAGE_SIZE)

					{

						printf("Read Byte Missing %u bytes\r\n", _buffer_index);

					}

#endif

        _event->Release();

        break;



      case INT_EEPROM_DATA:

        if (_buffer_index < EEPROM_INT_PAGE_SIZE)

        {

          _buffer [_buffer_index] = (char)data;

          _buffer_index++;

        }



        if (_buffer_index == EEPROM_INT_PAGE_SIZE)

        {

          _event->Release();

        }

        break;



      default:

        const char* message = "NVRAMStore::AddByte UNKNOWN Flags \r\n";



        DisplayDiags (message);



				printf ("UNKNOWN %x\r\n", flags);

        ret = false;

      }



    return ret;



  //## end NVRAMStore::AddByte%1031888838.body

}



//## Operation: ProcessReceiveData%1031888839

void NVRAMStore::ProcessReceiveData ()

{

  //## begin NVRAMStore::ProcessReceiveData%1031888839.body preserve=yes

  //flag to determine whether we are testing or reading

  const bool doing_test = _state == testing;

  unsigned index = 0;

  const char* data = (char*) _buffer;

  const unsigned buf_size = _buffer_index;

	IOData out_data;



	if (_buffer_index < EEPROM_READ_PAGE_SIZE)

		{

			_failed = true;



			const char* message = "NVRAMStore::ProcessReceiveData Insufficient Bytes\r\n";



			DisplayDiags (message);

			printf ("%s", message);

			IOData out_data = EEPROM_REBOOT * 0x100;

			MidiOutputDriver::TransmitIoData (out_data);

							

		}

	else

		{

			if (!_total_num_bytes)

				{

					printf ("TestHeader\r\n");

					index = TestHeader (data, buf_size - index);

					

#ifdef TRY_RX_RETRY

					// we will force a retry for the first rx

					

					if (!_num_rx_retries)

						{

							_failed = true;

							printf ("Force a retry\r\n");

						}

					

#endif

					

					

					// read the total files expected

					if (!_failed)

						{

							_num_files = (unsigned) (data [index++]);

							printf ("Restore %u files\r\n", _num_files);



							for (unsigned i = 0; i < _num_files; i++)

								{

									FilesList.push_back(FileBlock());

								}

						}

				} // end header

		}



  while (!_failed && _current_file_index < _num_files && index < buf_size)

  {

    const char* rx_buf = data + index;

    index += FilesList [_current_file_index].WriteBytes (rx_buf, buf_size - index, doing_test);



    if (FilesList [_current_file_index].Complete())

    {

      _failed = FilesList [_current_file_index].Failed();

      _current_file_index++;

    }

  }

	

	_total_num_bytes += index;

	

  _buffer_index = 0;

	

  if (_failed || _current_file_index >= _num_files)

		{

			if (_failed)

				{

          IOData out_data = EEPROM_REBOOT * 0x100;

          MidiOutputDriver::TransmitIoData (out_data);



					printf ("Restore Failed %u", _num_rx_retries + 1);



					_failed = false;



					if (_num_rx_retries < NUM_RETRIES)

						{

							_num_rx_retries++;

							ReadFiles ();

						}

					else // all failed

						{

							// we have failed all the times

							printf ("All Failed\r\n");



							// see if we were testing -- if yes then we will try to do a transmit again

							if (_state == testing && _num_tx_retries < NUM_RETRIES)

								{

									_num_tx_retries++;

									printf ("Retry TX %u", _num_tx_retries);



									SaveFiles (0);

								}

							else

								{

									_state = idle;

									// re-enable the IO

									out_data = EEPROM_END * 0x100;

									MidiOutputDriver::TransmitIoData (out_data);

									_num_tx_retries = 0;

								}

						} // end all failed



				} // end failed

			else // we passed

				{

					const char* message = "Files Passed\r\n";

					DisplayDiags (message);



					_current_file_index = 0;

					_total_num_bytes = 0;

					_num_rx_retries = 0;

					

					// set our address to zero on our external device

					out_data = EEPROM_INIT_ADDRESS *  0x100;

					MidiOutputDriver::TransmitIoData (out_data);

					

					if (_state == testing)

						{

							WriteIntEEprom ();

						}

					else

						{

							_state = read_internal;

							// request the Internal eeprom

							out_data = INT_EEPROM_READ *  0x100;

							MidiOutputDriver::TransmitIoData (out_data);

						}

					

					out_data = EEPROM_END * 0x100;

					MidiOutputDriver::TransmitIoData (out_data);

				} // end passed

		} // more to go

	else

		{

			// now poll for our receive data and pass to running thread

			IOData out_data = EEPROM_BLOCK_READ *  0x100;

			MidiOutputDriver::TransmitIoData (out_data);

		}



  //## end NVRAMStore::ProcessReceiveData%1031888839.body

}



//## Operation: ProcessTransmitData%1031888840

//	Read from the files and send data to IO

void NVRAMStore::ProcessTransmitData ()

{

  //## begin NVRAMStore::ProcessTransmitData%1031888840.body preserve=yes

  unsigned num_bytes = 0;

  char tx_buff [EEPROM_WRITE_PAGE_SIZE];



  if (! _total_num_bytes)

  {

    // get the number of files. Max of 255 and store in our tx buffer

    num_bytes = ReadHeader ((char*)tx_buff, EEPROM_WRITE_PAGE_SIZE);

    tx_buff [num_bytes++] = (char)GetNumFiles();

  }



  // request a write to memory

  while (num_bytes < EEPROM_WRITE_PAGE_SIZE && _current_file_index < GetNumFiles())

  {

    num_bytes += FilesList [_current_file_index].ReadBytes((char*)tx_buff + num_bytes, EEPROM_WRITE_PAGE_SIZE - num_bytes);



    if (FilesList [_current_file_index].Complete())

    {

      FilesList [_current_file_index].FreeResources();

      _current_file_index++;

    }

  }



  _total_num_bytes += num_bytes;



  for (unsigned i = 0; i < num_bytes; i++)

  {

    IOData out_data =  (IOData) ((EEPROM_DATA * 0x100) | (tx_buff [i] & 0xff));



    MidiOutputDriver::TransmitIoData (out_data);

  }



  // we need to do end write here

  IOData out_data = EEPROM_END_WRITE *  0x100;

  MidiOutputDriver::TransmitIoData (out_data);



  // now see if we have to write more later

  if (_current_file_index >= GetNumFiles())

  {

    _state = testing;



		const char* message = "NVRAMStore::ProcessTransmitData Testing Files\r\n";



		DisplayDiags (message);



		printf ("TestingFiles\r\n");

    ReadFiles();

  }

  else

  {

    IOData out_data = EEPROM_START_WRITE *  0x100;

    MidiOutputDriver::TransmitIoData (out_data);

  }



  //## end NVRAMStore::ProcessTransmitData%1031888840.body

}



//## Operation: LoadFiles%1031888841

//	Loads the file information in preparation for Saving or

//	testing

bool NVRAMStore::LoadFiles (const char* path)

{

  //## begin NVRAMStore::LoadFiles%1031888841.body preserve=yes

    bool ret = 0;

    DIR *dir;

    struct dirent *ent;

    char dir_buffer [100];

    char filename_buffer [256];



    strcpy (dir_buffer,  path);

		

		EraseFilesList();



	  if ((dir = opendir(dir_buffer)) == NULL)

		  {

				const char* message = "NVRAMStore::Load File Unable to open directory\r\n";



				DisplayDiags (message);



				printf ("\r\nUnable to open directory named %s\r\n", path);

		  }

	  else

		  {

      ret = true;

			rewinddir (dir);

			printf ("\r\nLoading Files %s\r\n", path);

			while ((ent = readdir(dir)) != NULL)

				{

          strcpy (filename_buffer, path);

          strcat (filename_buffer, ent->d_name);

          FileBlock this_file (filename_buffer);



          if (this_file.GetFileLength())

          {

					  FilesList.push_back (this_file);

						printf ("SavingFile %s %u bytes\r\n", filename_buffer, (unsigned) (this_file.GetFileLength()));

          }

				}

			if (closedir(dir) != 0)

				{

					printf("\r\nUnable to close directory");

				}

		  }



    return ret;

  //## end NVRAMStore::LoadFiles%1031888841.body

}



//## Operation: create%1031960275

//	Creates a store to run in its own thread

void NVRAMStore::create ()

{

  //## begin NVRAMStore::create%1031960275.body preserve=yes

  if (!this_store)

  {

		printf("Creating NVRAMSTORE\r\n");

    this_store = new NVRAMStore;

    if (this_store)

      {

        this_store->start();

      }

  }

  //## end NVRAMStore::create%1031960275.body

}



//## Operation: flush%1031960276

//	Abstract function that tells superclass to stop what it

//	is doing and return.

void NVRAMStore::flush ()

{

  //## begin NVRAMStore::flush%1031960276.body preserve=yes

	printf ("NVRAMStore::flush\r\n");

  _event->Release();

  //## end NVRAMStore::flush%1031960276.body

}



//## Operation: IsIdle%1032126395

//	Function to acertain whether we are in an idle state or

//	active

bool NVRAMStore::IsIdle ()

{

  //## begin NVRAMStore::IsIdle%1032126395.body preserve=yes

  bool ret = true;



  if (this_store)

    {

      ret = this_store->_state == idle;

    }



  return ret;



  //## end NVRAMStore::IsIdle%1032126395.body

}



//## Operation: ReadHeader%1032126396

//	Reads the header of the NVRAM and storfes inReturn Buffer

//	returns the number of bytes read

unsigned NVRAMStore::ReadHeader (char* ret_buf, unsigned buf_len)

{

  //## begin NVRAMStore::ReadHeader%1032126396.body preserve=yes

  unsigned bytes_written;



  // first write header

  for (bytes_written = 0; bytes_written < strlen (_header_name) && bytes_written < buf_len; bytes_written++)

  {

    ret_buf[bytes_written] = _header_name[bytes_written];

  }



  return bytes_written;

  //## end NVRAMStore::ReadHeader%1032126396.body

}



//## Operation: TestHeader%1032126397

//	Test the header of the NVRAM

//	returns the number of bytes read

//## Postconditions:

//	If the Header is not valid, the _failed flag will become

//	true

unsigned NVRAMStore::TestHeader (const char* buf, unsigned buf_len)

{

  //## begin NVRAMStore::TestHeader%1032126397.body preserve=yes

  unsigned bytes_read;



  for (bytes_read = 0; bytes_read < strlen (_header_name) && bytes_read  < buf_len && !_failed; bytes_read++)

  {

    _failed = _failed || (buf[bytes_read] != _header_name[bytes_read]);

		if (_failed)

			{

        const char* message = "NVRAMStore::TestHeader Invalid Header Byte \r\n";



        DisplayDiags (message);



				printf ("Invalid Header Read %u, expected %u\r\n", buf[bytes_read],_header_name[bytes_read]);

			}

  }



  _failed = _failed || bytes_read != strlen (_header_name);



	if (_failed)

		{

			printf ("Test Header _failed || bytes_read != strlen (_header_name)\r\n");

			bytes_read = 0;

		}





  return bytes_read;

  //## end NVRAMStore::TestHeader%1032126397.body

}



//## Operation: ProcessInternal%1032171145

//	Read from the files and send data to IO

void NVRAMStore::ProcessInternal ()

{

  //## begin NVRAMStore::ProcessInternal%1032171145.body preserve=yes

  bool valid = false;

	const char* filename = (const char*)_internal_NVRAM;



  for (unsigned i = 0; i < EEPROM_INT_PAGE_SIZE; i++)

  {

    _internal_NVRAM[i] = _buffer[i];

    // check for a NULL at the end

    valid = valid || !_internal_NVRAM[i];

  }



  // we have to re-enable the IO

  IOData out_data = EEPROM_END * 0x100;

  MidiOutputDriver::TransmitIoData (out_data);

  _state = idle;



	if (valid && strlen (filename))

		{



      const char* message = "NVRAMStore::ProcessInternal Loading Patch \r\n";



      DisplayDiags (message);



			printf ("Loading Patch %s\r\n", filename);

			if (Patch::LoadPatchFile(filename))

				{

          message = "Loaded Patch";

          DisplayDiags (message);



          message = filename;

          DisplayDiags (message);



					printf ("Loaded Patch %s\r\n", filename);

				}

			else

				{

          message = "Unable to Load Patch";

          DisplayDiags (message);



          message = filename;

          DisplayDiags (message);



					printf ("Loaded Patch %s\r\n", filename);



					printf ("Unable to load %s\r\n", filename);

				}

		}

	else

		{

			const char* message = "No Current Patch\r\n";



			DisplayDiags (message);



			printf ("No Current Patch\r\n");

		}



  //## end NVRAMStore::ProcessInternal%1032171145.body

}



//## Operation: WriteIntEEprom%1032171146

//	Writes Internal EEprom to IO

void NVRAMStore::WriteIntEEprom ()

{

  //## begin NVRAMStore::WriteIntEEprom%1032171146.body preserve=yes

  // get the current patch

  Patch* current_patch = Patch::GetPatch(0);



  if (current_patch)

  {

    current_patch->GetFileName ((char*)_internal_NVRAM, sizeof (_internal_NVRAM));

    printf ("CurrentFile is %s\r\n", (const char*)_internal_NVRAM);

  }



  IOData out_data = EEPROM_INIT_ADDRESS *  0x100;

  MidiOutputDriver::TransmitIoData (out_data);



  for (unsigned i = 0; i < EEPROM_INT_PAGE_SIZE; i++)

  {

    out_data = (IOData )((INT_EEPROM_DATA *  0x100) | (_internal_NVRAM[i] & 0xff));    MidiOutputDriver::TransmitIoData (out_data);



  }

  _state = idle;

  //## end NVRAMStore::WriteIntEEprom%1032171146.body

}



//## Operation: EraseNVRAM%1032171147

//	Erase the Contents of NVRAM so they will not load on

//	startup

void NVRAMStore::EraseNVRAM ()

{

  //## begin NVRAMStore::EraseNVRAM%1032171147.body preserve=yes



	const char* nvram_file = GetNVRAMFilename();



	if (nvram_file)

		{

			FILE* fp = fopen(nvram_file, "w+b");

			if (fp)

				{

					printf ("Erase NVRAM %s\r\n", nvram_file);

					

					WriteHeader(fp);

					char num_files = 0;

					

					fwrite (&num_files, 1, 1, fp);

					// write zero Patches also

					fwrite (&num_files, 1, 1, fp);

					

					fflush(fp);

					fsync(fileno(fp));

					fclose(fp);

					SyncNVRAM();

					Restart();

				}

			else

				{

					printf ("Erase NVRAM %s unable to open\r\n", nvram_file);

				}



			

		}

	

#ifdef USE_EEPROM

  // this code has been removed during port to IDE

  create();





	if (this_store->_state == idle)

		{

			printf ("Erase NVRAM\r\n");

			EraseFilesList();



			IOData out_data = EEPROM_START * 0x100;

			MidiOutputDriver::TransmitIoData (out_data);

			

			this_store->_state = erasing;

			this_store->_buffer_index = 0;

			this_store->_total_num_bytes = 0;

			this_store->_current_file_index = 0;

			

			// set our address to zero

			out_data = EEPROM_INIT_ADDRESS *  0x100;

			MidiOutputDriver::TransmitIoData (out_data);

			

			// Request permission to write and pass to running thread

			// request a write to memory

			out_data = EEPROM_START_WRITE *  0x100;

			MidiOutputDriver::TransmitIoData (out_data);

		}

#endif

  //## end NVRAMStore::EraseNVRAM%1032171147.body

}



//## Operation: ProcessTimeout%1045109262

//	Processes a Failuer due to a timeout

void NVRAMStore::ProcessTimeout ()

{

  //## begin NVRAMStore::ProcessTimeout%1045109262.body preserve=yes

	IOData out_data = EEPROM_REBOOT * 0x100;

	MidiOutputDriver::TransmitIoData (out_data);

	

	printf ("Restore Failed %u", _num_rx_retries + 1);



	_failed = false;

	

	if (_num_rx_retries < NUM_RETRIES)

		{

			_num_rx_retries++;

			ReadFiles ();

		}

	else // all failed

		{

			// we have failed all the times

			printf ("All Failed\r\n");

			

			// see if we were testing -- if yes then we will try to do a transmit again

			if (_state == testing && _num_tx_retries < NUM_RETRIES)

				{

					_num_tx_retries++;

					printf ("Retry TX %u\r\n", _num_tx_retries);



					SaveFiles (0);

				}

			else

				{

					_state = idle;

					// re-enable the IO

					out_data = EEPROM_END * 0x100;

					MidiOutputDriver::TransmitIoData (out_data);

					_num_tx_retries = 0;

				}

		} // end all failed





  //## end NVRAMStore::ProcessTimeout%1045109262.body

}



//## Operation: WriteHeader%1050531909

//	Writes the Header to the File

//	Assumes valid File Pointer

bool NVRAMStore::WriteHeader (FILE* fp)

{

  //## begin NVRAMStore::WriteHeader%1050531909.body preserve=yes

  return fwrite (_header_name, strlen (_header_name), 1, fp);

  //## end NVRAMStore::WriteHeader%1050531909.body

}



//## Operation: WriteFiles%1050531910

//	Writes the files, to File

bool NVRAMStore::WriteFiles (FILE* fp)

{

  //## begin NVRAMStore::WriteFiles%1050531910.body preserve=yes

  char num_files = (char)GetNumFiles();

  unsigned current_file_index = 0;

  bool finished = GetNumFiles() <= current_file_index;



	printf ("Write Files to Disk\r\n");

  bool success = fwrite (&num_files, 1, 1, fp);



  // write all files to disk

  while (success && !finished)

  {

    char tx_buff [EEPROM_WRITE_PAGE_SIZE];

    unsigned num_bytes = FilesList [current_file_index].ReadBytes((char*)tx_buff, sizeof (tx_buff));



    success = fwrite(tx_buff, num_bytes, 1, fp);



    if (FilesList [current_file_index].Complete())

    {

      FilesList [current_file_index].FreeResources();

      current_file_index++;

    }



    finished = GetNumFiles() <= current_file_index;

  }



  

  return success;

  //## end NVRAMStore::WriteFiles%1050531910.body

}



//## Operation: WritePatches%1050531911

//	Writes the PatchNames to load to File

bool NVRAMStore::WritePatches (FILE* fp)

{

  //## begin NVRAMStore::WritePatches%1050531911.body preserve=yes

	bool ret = true;

  unsigned char num_patches = (unsigned char)Patch::NumPatches();



	// write the number of patches there are

	fwrite (&num_patches, 1, 1, fp);



	for (unsigned i = 0; i < num_patches; i++)

		{

			Patch* current_patch = Patch::GetPatch(i);



			if (current_patch)

				{

					char buf [255];

					current_patch->GetFileName ((char*)buf, sizeof (buf));

					printf ("Current Patch is %s\r\n", (const char*)buf);



					// now write that value

					ret &= fwrite (buf, strlen(buf)+1, 1, fp);

				}

		}

	return ret;

  //## end NVRAMStore::WritePatches%1050531911.body

}



//## Operation: ReadPatches%1050531912

//	Reads the Patches From File

bool NVRAMStore::ReadPatches (FILE* fp, bool doing_test)

{

  //## begin NVRAMStore::ReadPatches%1050531912.body preserve=yes

  unsigned char num_patches = 0;



	// read the total patches expected

  bool ret = fread (&num_patches, 1, 1, fp);

	unsigned current_patch_index = 0;

	unsigned buf_index = 0;



	char buff [256];



	while (ret && current_patch_index < num_patches)

		{

			char c;

			ret = (fread (&c, 1, 1, fp) && (buf_index < sizeof (buff)));

			if (ret)

				{

					buff [buf_index] = c;





					// now check for the null char to see if we have a full patch name

					if (!c)

						{

							printf ("Loading Patch %s\r\n", buff);

              if (!doing_test)

              {

							  Patch::LoadPatchFile(buff);

              }

              

							buf_index = 0;

							current_patch_index++;

						}

					else

						{

							buf_index++;

						}



				}

    }



    return ret;

  //## end NVRAMStore::ReadPatches%1050531912.body

}



//## Operation: ReadFiles%1050531913

//	Reads the Files From File

bool NVRAMStore::ReadFiles (FILE* fp, bool doing_test)

{

  //## begin NVRAMStore::ReadFiles%1050531913.body preserve=yes

  unsigned char num_files = 0;



	// read the total files expected

  bool ret = fread (&num_files, 1, 1, fp);

	unsigned current_file_index = 0;

	

	char message [256];



	sprintf (message, "Restore %u files\r\n", num_files);

	DisplayDiags (message);

	printf ("%s", message);



  if (ret)

  {

		EraseFilesList();





		for (unsigned i = 0; i < num_files; i++)

			{

				FilesList.push_back(FileBlock());

			}

		

  }



  while (ret && current_file_index < num_files)

  {

		char c;

		ret = fread (&c, 1, 1, fp);



		if (!ret)

			{

				sprintf (message, "Failed Read File\r\n");

				DisplayDiags (message);

				printf ("%s", message);

			}

		

		FilesList [current_file_index].WriteBytes (&c, 1, doing_test);



    if (FilesList [current_file_index].Complete())

    {

			if (FilesList [current_file_index].Failed())

				{

					sprintf (message, "FilesList Fail\r\n");

					DisplayDiags (message);

					printf ("%s", message);

					ret = false;

				}

   

      current_file_index++;

    }

  }



  return ret;

  //## end NVRAMStore::ReadFiles%1050531913.body

}



//## Operation: ReadHeader%1050531914

//	Reads the Header From File

bool NVRAMStore::ReadHeader (FILE* fp)

{

  //## begin NVRAMStore::ReadHeader%1050531914.body preserve=yes

	char buf [32];



	bool ret = fread (buf, strlen(_header_name), 1, fp);



	if (ret)

		{

			printf ("TestHeader\r\n");

			ret = this_store->TestHeader(buf, strlen(_header_name));

		}



	return ret;

  //## end NVRAMStore::ReadHeader%1050531914.body

}



//## Operation: EraseFilesList%1050531915

//	Erases the file list

void NVRAMStore::EraseFilesList ()

{

  //## begin NVRAMStore::EraseFilesList%1050531915.body preserve=yes

	for (unsigned i = 0; i < FilesList.size(); i++)

		{

			FilesList[i].FreeResources();

		}                

	

  FilesList.clear ();



  //## end NVRAMStore::EraseFilesList%1050531915.body

}



// Additional Declarations

  //## begin NVRAMStore%3D802415035A.declarations preserve=yes

extern "C" void RestoreNVRAM()

{

	NVRAMStore::RestoreFiles ();

	const char* message = "Restore Files\r\n";

	DisplayDiags (message);

}

  //## end NVRAMStore%3D802415035A.declarations

//## begin module%3D802415035A.epilog preserve=yes

//## end module%3D802415035A.epilog

